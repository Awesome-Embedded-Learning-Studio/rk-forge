## board/rk3588-topeet/fit/rk3588-kernel.its
```
/*
 * 主线 Linux 内核 FIT (RK3588 topeet, eMMC 引导用)。
 * 一个 .itb 含 Image(arm64 kernel) + rk3588-evb1-v10.dtb(fdt), 不含 ramdisk。
 *
 * MVP: 复用主线 rk3588-evb1-v10.dtb (零板级 DT patch) 验证主线链路。Phase 5 板 DT
 * (rk3588-topeet.dts, 从 vendor topeet-rk3588-linux.dts 移植) 落地后, DT_NAME 切换,
 * 此处 incbin 改 "rk3588-topeet.dtb"。
 *
 * load 地址取自主线 U-Boot include/configs/rk3588_common.h 的 ENV_MEM_LAYOUT_SETTINGS:
 *   kernel_addr_r=0x02000000   fdt_addr_r=0x12000000
 * 注意: RK3588 的这两个地址与 RK3568 完全相同 (RK3568 也是 0x02000000/0x12000000),
 * 所以本 its 的 load/entry 与 rk3568-kernel.its 一致, 只是 DT 名 + description 不同。
 *
 * eMMC primary boot: 无 provisioning initramfs (那是 aes NAND/ubiprog 专属), 内核直接
 * 按 bootargs 的 root=/dev/mmcblk?1p3 挂 eMMC 的 ext4 rootfs。与 rk3568-atk 同构。
 *
 * 打包: fit-pack.py pack --external-offset 0x800 (Mode B, 主线 U-Boot bootm 消费)。
 */
/dts-v1/;

/ {
	description = "Mainline Linux FIT for RK3588 topeet (eMMC ext4 rootfs boot)";
	#address-cells = <1>;

	images {

		kernel {
			description = "Linux kernel (arm64 Image, self-decompressing)";
			data = /incbin/("Image");
			type = "kernel";
			arch = "arm64";
			os = "linux";
			compression = "none";
			load = <0x02000000>;
			entry = <0x02000000>;
			hash {
				algo = "sha256";
			};
		};

		fdt {
			description = "Topeet RK3588 board DT (ported from vendor; bootargs set by U-Boot: root=/dev/mmcblk?1p3)";
			data = /incbin/("rk3588-topeet.dtb");
			type = "flat_dt";
			arch = "arm64";
			compression = "none";
			load = <0x12000000>;
			hash {
				algo = "sha256";
			};
		};
	};

	configurations {
		default = "conf";
		conf {
			description = "Boot mainline arm64 Linux, mount eMMC ext4 rootfs";
			kernel = "kernel";
			fdt = "fdt";
		};
	};
};
```

## boards/aes/fit/rk3506-kernel-nand.its
```
/*
 * 主线 Linux 内核 FIT — NAND 真根版(RK3506B,从 rootfs 分区挂 UBIFS rootfs)。
 * 与 rk3506-kernel.its 的区别: **不含 ramdisk 节点**。这样内核不会 unpack
 * initramfs 去 exec /init,而是按 bootargs 的 root=ubi0:rootfs 直接 attach UBI、
 * 挂 UBIFS 为根,再 exec /sbin/init(busybox init)。
 *
 * 兄弟镜像:
 *   boot.img      ← rk3506-kernel.its      (zImage+dtb+initramfs)  fallback/调试 shell
 *   boot-nand.img ← 本文件                 (zImage+dtb,无 ramdisk)  NAND UBIFS rootfs
 * 同一份 rk3506b-aes.dtb(DT bootargs 已含 root=);ramdisk 缺省即走真根。
 *
 * 打包: vendor/explore uboot mkimage -f rk3506-kernel-nand.its -E -p 0x800 boot-nand.itb
 */

/dts-v1/;

/ {
	description = "Mainline Linux FIT for RK3506B (NAND UBIFS rootfs boot)";
	#address-cells = <1>;

	images {

		kernel {
			description = "Linux kernel (zImage, self-decompressing)";
			data = /incbin/("zImage");
			type = "kernel";
			arch = "arm";
			os = "linux";
			compression = "none";
			load = <0x02080000>;
			entry = <0x02080000>;
			hash {
				algo = "sha256";
			};
		};

		fdt {
			description = "RK3506B AES board flat DT (bootargs: ubi.mtd=5 root=ubi0:rootfs)";
			data = /incbin/("rk3506b-aes.dtb");
			type = "flat_dt";
			arch = "arm";
			compression = "none";
			load = <0x01e00000>;
			hash {
				algo = "sha256";
			};
		};
	};

	configurations {
		default = "conf";
		conf {
			description = "Boot mainline Linux, mount NAND UBIFS rootfs";
			kernel = "kernel";
			fdt = "fdt";
		};
	};
};
```

## third_party/bringup/fit/rk3506-kernel.its
```
/*
 * 主线 Linux 内核 FIT(RK3506B,NAND 引导用)。
 * 一个 .itb 含 zImage(kernel)+ rk3506b-aes.dtb(fdt)。
 * U-Boot mtd read boot ${kernel_addr_r}; bootm ${kernel_addr_r} 加载。
 * load 地址用 rk3506_common.h 的 env(kernel_addr_r=0x02080000, fdt_addr_r=0x01e00000)。
 * 打包:vendor mkimage -f rk3506-kernel.its -E -p 0x800 rk3506-kernel.itb
 *   (-E external data, RK SPL 读取约定; -p 0x800 image position align, 同 vendor zboot.its)
 */

/dts-v1/;

/ {
	description = "Mainline Linux FIT for RK3506B (NAND boot)";
	#address-cells = <1>;

	images {

		kernel {
			description = "Linux kernel (zImage, self-decompressing)";
			data = /incbin/("zImage");
			type = "kernel";
			arch = "arm";
			os = "linux";
			compression = "none";
			load = <0x02080000>;
			entry = <0x02080000>;
			hash {
				algo = "sha256";
			};
		};

		fdt {
			description = "RK3506B AES board flat DT";
			data = /incbin/("rk3506b-aes.dtb");
			type = "flat_dt";
			arch = "arm";
			compression = "none";
			load = <0x01e00000>;
			hash {
				algo = "sha256";
			};
		};
	};

	configurations {
		default = "conf";
		conf {
			description = "Boot mainline Linux with FDT";
			kernel = "kernel";
			fdt = "fdt";
		};
	};
};
```

## third_party/bringup/fit/rk3506-mainline.its
```
/*
 * 方案 B: vendor SPL + 我们主线 U-Boot 的 FIT
 * 结构 100% 复刻 vendor uboot.img(见 reference/vendor-sdk/u-boot/uboot.img 的 dumpimage),
 * 唯一改动: uboot 节点的 data 换成主线 2026.07-rc4 的 u-boot-nodtb.bin,
 *           load 改成 0x00800000(主线 CONFIG_TEXT_BASE; vendor 原是 0x00200000)。
 * optee/fdt 节点 load/结构不动 — vendor SPL 已证明能跑这套布局。
 * 用 vendor mkimage(2017.09) + -E 打包, 与 vendor SPL 字节级兼容。
 */

/dts-v1/;

/ {
	description = "FIT Image with ATF/OP-TEE/U-Boot/MCU";
	#address-cells = <1>;

	images {

		uboot {
			description = "U-Boot";
			data = /incbin/("uboot-nodtb.bin");
			type = "standalone";
			arch = "arm";
			os = "U-Boot";
			compression = "none";
			load = <0x00800000>;
			hash {
				algo = "sha256";
			};
		};

		optee {
			description = "OP-TEE";
			data = /incbin/("tee.bin");
			type = "firmware";
			arch = "arm";
			os = "op-tee";
			compression = "none";
			entry = <0x00001000>;
			load = <0x00001000>;
			hash {
				algo = "sha256";
			};
		};

		fdt {
			description = "U-Boot dtb";
			data = /incbin/("u-boot.dtb");
			type = "flat_dt";
			arch = "arm";
			compression = "none";
			hash {
				algo = "sha256";
			};
		};
	};

	configurations {
		default = "conf";
		conf {
			description = "rk3506-evb-mainline";
			firmware = "optee";
			loadables = "uboot";
			fdt = "fdt";
		};
	};
};
```
