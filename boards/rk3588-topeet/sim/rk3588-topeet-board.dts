// SPDX-License-Identifier: (GPL-2.0+ OR MIT)
/*
 * 真板 DTB 的 sim 叠加层：include rk3588-topeet.dts 后做最小手术。
 * dtc 保证结构合法（运行时 fdt_delprop 会让内核 OF 遍历死循环——of_clk_init
 * 活锁，见笔记 72）。差异诚实清单：
 *   - vin-supply 删除：vcc3v3-lcd-n 不再挂 SPI PMIC 的 dcdc-reg8 下游
 *     （PMIC 需 SPI 行为模型，挂账课题），regulator-fixed 独立成立。
 *   - vop 的 iommus 删除：真板走 vop_mmu 翻译（真硬件 iommu 正常）；
 *     仿真的 rockchip-iommu 两级页表行为未建模完整，dma 半残（fb 的
 *     iova 映射不完整，plane 拿到内核不认识的地址）。摘掉后 dma 直通，
 *     fb 地址即物理地址，CMA 连续，扫描输出直读。vop_mmu 影子保留
 *     （probe 不再因它触发）。见笔记 74。
 */
/dts-v1/;

#include "rk3588-topeet.dts"

/ {
};

&vcc3v3_lcd_n {
	/delete-property/ vin-supply;
};

&vop {
	/delete-property/ iommus;
};
